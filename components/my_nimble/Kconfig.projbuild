## components/my_nimble/Kconfig.projbuild
```kconfig
menu "UniLAB BT"
    config MY_NIMBLE_BT_ENABLED
    bool "Enable"
    default n
    select

endmenu
```

## my_nimble/Kconfig.projbuild
```kconfig
menu "UniLAB BT"
    config MY_NIMBLE_BT_ENABLED
    bool "Enable"
    default n
endmenu
```
